## firmware/wansview_k5_t21n_ov2735b_rtl8188fu/wansview_k5_t21n_ov2735b_rtl8188fu_defconfig
```kconfig
# NAME: Wansview K5 (T21N, OV2735B, RTL8188FU, 16MiB SPI NOR) EXPERIMENTAL
# BASE: themactep/thingino-firmware:configs/cameras/wansview_k5_t21n_ov2735b_mt7601u
# FRAG: soc-xburst1 core
BR2_INGENIC_SOC_MODEL="t21n"
BR2_LINUX_KERNEL_CONFIG_FRAGMENT_FILES="$(BR2_EXTERNAL_THINGINO_PATH)/configs/cameras/wansview_k5_t21n_ov2735b_rtl8188fu/kernel-stockboot.fragment"
BR2_PACKAGE_THINGINO_KOPT_MMC0=y
BR2_PACKAGE_THINGINO_KOPT_MMC0_PB_4BIT=y
BR2_PACKAGE_WIFI=y
BR2_PACKAGE_WIFI_RTL8188FU=y
BR2_ROOTFS_POST_BUILD_SCRIPT="$(BR2_EXTERNAL_THINGINO_PATH)/scripts/rootfs_script.sh $(BR2_EXTERNAL_THINGINO_PATH)/configs/cameras/wansview_k5_t21n_ov2735b_rtl8188fu/post-build.sh"
BR2_SENSOR_1_NAME="ov2735b"
BR2_SENSOR_1_PARAMS="sensor_gpio_func=0"
BR2_THINGINO_AUDIO=y
BR2_THINGINO_BUTTON=y
BR2_THINGINO_LED_B_ACTIVE_LOW=y
BR2_THINGINO_LED_B_GPIO=73
BR2_THINGINO_LED_R_ACTIVE_LOW=y
BR2_THINGINO_LED_R_GPIO=72
BR2_THINGINO_SDCARD=y
FLASH_SIZE_MB=16
```
